## configs/brennan_defconfig
```kconfig
BR2_arm=y
BR2_arm1176jzf_s=y
BR2_STRIP_none=y
BR2_KERNEL_HEADERS_VERSION=y
BR2_DEFAULT_KERNEL_VERSION="3.12.28"
BR2_PACKAGE_HOST_LINUX_HEADERS_CUSTOM_3_12=y
BR2_TOOLCHAIN_BUILDROOT_LARGEFILE=y
BR2_TOOLCHAIN_BUILDROOT_INET_IPV6=y
BR2_TOOLCHAIN_BUILDROOT_WCHAR=y
BR2_PTHREAD_DEBUG=y
BR2_TOOLCHAIN_BUILDROOT_CXX=y
BR2_TARGET_GENERIC_HOSTNAME="BrennanB2"
BR2_TARGET_GENERIC_ISSUE="Welcome to Brennan B2"
BR2_TARGET_GENERIC_ROOT_PASSWD="brennan"
BR2_TARGET_GENERIC_GETTY_PORT="tty1"
BR2_ROOTFS_OVERLAY="board/brennan/b2/rootfs_overlay"
BR2_ROOTFS_POST_BUILD_SCRIPT="board/brennan/b2/post_build.sh"
BR2_ROOTFS_POST_IMAGE_SCRIPT="board/brennan/b2/post_image.sh"
BR2_LINUX_KERNEL=y
BR2_LINUX_KERNEL_CUSTOM_GIT=y
BR2_LINUX_KERNEL_CUSTOM_REPO_URL="git://github.com/raspberrypi/linux.git"
BR2_LINUX_KERNEL_CUSTOM_REPO_VERSION="c256eb9968c8997dce47350d2075e42f1b3991d3"
BR2_LINUX_KERNEL_USE_CUSTOM_CONFIG=y
BR2_LINUX_KERNEL_CUSTOM_CONFIG_FILE="board/brennan/b2/linux.config"
BR2_LINUX_KERNEL_ZIMAGE=y
BR2_PACKAGE_BUSYBOX_CONFIG="board/brennan/b2/busybox.config"
BR2_PACKAGE_BUSYBOX_SHOW_OTHERS=y
BR2_PACKAGE_ALSA_UTILS=y
BR2_PACKAGE_ALSA_UTILS_APLAY=y
BR2_PACKAGE_ALSA_UTILS_SPEAKER_TEST=y
BR2_PACKAGE_FFMPEG=y
BR2_PACKAGE_GDB=y
BR2_PACKAGE_GDB_SERVER=y
BR2_PACKAGE_GDB_DEBUGGER=y
BR2_PACKAGE_GDB_TUI=y
BR2_PACKAGE_DOSFSTOOLS=y
BR2_PACKAGE_DOSFSTOOLS_FSCK_FAT=y
BR2_PACKAGE_DOSFSTOOLS_MKFS_FAT=y
BR2_PACKAGE_DEJAVU=y
BR2_PACKAGE_LINUX_FIRMWARE=y
BR2_PACKAGE_LINUX_FIRMWARE_RALINK_RT2XX=y
BR2_PACKAGE_RPI_FIRMWARE=y
BR2_PACKAGE_PARTED=y
BR2_PACKAGE_LIBCDIO=y
BR2_PACKAGE_FREETYPE=y
BR2_PACKAGE_GOOGLEFONTDIRECTORY=y
BR2_PACKAGE_BLUEZ_UTILS=y
BR2_PACKAGE_BLUEZ_UTILS_AUDIO=y
BR2_PACKAGE_BLUEZ_UTILS_USB=y
BR2_PACKAGE_IFPLUGD=y
BR2_PACKAGE_LIGHTTPD=y
BR2_PACKAGE_NTP=y
BR2_PACKAGE_OPENSSH=y
BR2_PACKAGE_SAMBA4=y
BR2_PACKAGE_WIRELESS_TOOLS=y
BR2_PACKAGE_WPA_SUPPLICANT=y
BR2_PACKAGE_WPA_SUPPLICANT_EAP=y
BR2_PACKAGE_WPA_SUPPLICANT_CLI=y
BR2_PACKAGE_WPA_SUPPLICANT_PASSPHRASE=y
BR2_PACKAGE_B2=y
BR2_PACKAGE_BCM2835=y
BR2_PACKAGE_COVERART=y
BR2_PACKAGE_DISCID=y
BR2_PACKAGE_LIBCDDB=y
BR2_PACKAGE_MUSICBRAINZ=y
BR2_PACKAGE_RIP=y
BR2_PACKAGE_SPLASH=y
BR2_PACKAGE_QRENCODE=y
BR2_PACKAGE_RTL8812AU=y
```

## package/brennan/Config.in
```kconfig
source "package/brennan/b2/Config.in"
source "package/brennan/bcm2835/Config.in"
source "package/brennan/coverart/Config.in"
source "package/brennan/discid/Config.in"
source "package/brennan/libcddb/Config.in"
source "package/brennan/musicbrainz/Config.in"
source "package/brennan/rip/Config.in"
source "package/brennan/splash/Config.in"
source "package/brennan/qrencode/Config.in"
source "package/brennan/rtl8812au/Config.in"
```

## package/brennan/b2/Config.in
```kconfig
config BR2_PACKAGE_B2
	bool "b2app"
	select BR2_PACKAGE_WIRELESS_TOOLS_LIB
	help
	  Main B2 Application

	  http://brennan.co.uk
```

## package/brennan/bcm2835/Config.in
```kconfig
config BR2_PACKAGE_BCM2835
	bool "bcm2835"
	help
	  BCM library for Brennan B2 app

	  http://brennan.co.uk
```

## package/brennan/coverart/Config.in
```kconfig
config BR2_PACKAGE_COVERART
	bool "coverart"
	help
	  libcoverart

	  http://brennan.co.uk
```

## package/brennan/discid/Config.in
```kconfig
config BR2_PACKAGE_DISCID
	bool "discid"
	help
	  Musicbrainz libdiscid

	  http://brennan.co.uk
```

## package/brennan/libcddb/Config.in
```kconfig
config BR2_PACKAGE_LIBCDDB
	bool "libcddb"
	help
	  libcddb

	  http://brennan.co.uk
```

## package/brennan/musicbrainz/Config.in
```kconfig
config BR2_PACKAGE_MUSICBRAINZ
	bool "musicbrainz"
	help
	  libmusicbrainz

	  http://brennan.co.uk
```

## package/brennan/qrencode/Config.in
```kconfig
config BR2_PACKAGE_QRENCODE
	bool "qrencode"
	select BR2_PACKAGE_LIBPNG
	help
	  qrencode

	  http://brennan.co.uk
```

## package/brennan/rip/Config.in
```kconfig
config BR2_PACKAGE_RIP
	bool "rip"
	depends on BR2_PACKAGE_LIBCDIO && BR2_PACKAGE_LIBCDDB
	help
	  B2 Ripper test program

	  http://brennan.co.uk
```

## package/brennan/rtl8812au/Config.in
```kconfig
config BR2_PACKAGE_RTL8812AU
	bool "rtl8812au"
	help
	  Wifi kernel module for Realtek 8812/21 chipsets
	  
	  This driver is not currently upstreamed so has to be built
	  separately.

	  https://github.com/fariouche/rtl8812AU
```

## package/brennan/splash/Config.in
```kconfig
config BR2_PACKAGE_SPLASH
	bool "splash"
	depends on BR2_PACKAGE_BCM2835 && BR2_PACKAGE_FREETYPE
	help
	  Brennan Splash Screen Application

	  http://brennan.co.uk
```
